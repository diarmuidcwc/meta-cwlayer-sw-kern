## conf/layer.conf
```bitbake
# We have a conf and classes directory, add to BBPATH
BBPATH .= ":${LAYERDIR}"

# We have recipes-* directories, add to BBFILES
BBFILES += "${LAYERDIR}/recipes-*/*/*.bb \
			${LAYERDIR}/recipes-*/*/*.bbappend"

BBFILE_COLLECTIONS += "meta-cwlayer-sw-kern"
BBFILE_PATTERN_meta-cwlayer-sw-kern = "^${LAYERDIR}/"
BBFILE_PRIORITY_meta-cwlayer-sw-kern = "6"

LAYERDEPENDS_meta-cwlayer-sw-kern = "core"
LAYERSERIES_COMPAT_meta-cwlayer-sw-kern = "warrior zeus"
```
